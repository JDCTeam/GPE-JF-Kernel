## fs/exfat/Kconfig
```kconfig
config EXFAT_FS
	tristate "exFAT File System Support"
	default n
	select NLS
	select NLS_UTF8
	help
	  If you want to use the exFAT file systems, then you must say Y or M here
	  to inlucde exFAT support. 
```
